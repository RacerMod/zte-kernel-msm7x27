## drivers/i2c/chips/Kconfig
```kconfig
#
# Miscellaneous I2C chip drivers configuration
#
# *** DEPRECATED! Do not add new entries! See Makefile ***
#

menu "Miscellaneous I2C Chip support"

config SENSORS_TSL2771
	tristate "Taos TSL2771 ambient light and prox sensor"
	depends on I2C
	default n
	help
	  If you say yes here you get support for the Taos TSL2771
	  ambient light and proximity sensor.

config SENSORS_AK8973
	tristate "AKM8973 Compass Driver"
	depends on I2C
	default n
	help
	  If you say yes here you get support for Asahi Kasei's 
	  orientation sensor AK8973.

config SENSOR_LIS302DL
	tristate "ST LIS302DL acceleration sensor"
	depends on I2C
	default n
	help 
	  If your say yes here your get support for LIS302
	  acceleration sensor.
	  
config SENSOR_ADXL34X
	tristate "ADI ADXL34X acceleration sensor"
	depends on I2C
	default n
	help 
	  If your say yes here your get support for ADXL34X
	  acceleration sensor. 
	  
config SENSOR_ACCELERATOR
  tristate "ST&ADI acceleration sensor"
	depends on I2C
	default n
	help 
	  If your say yes here your get support for both ST and ADI 
	  acceleration sensors.

config SENSORS_MT9T013
	tristate "MT9T013 Camera Driver"
	depends on I2C
	default y
	help
	 MT9T013 Camera Driver implemented by HTC.

endmenu
```
